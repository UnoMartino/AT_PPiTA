#include <WiFi.h>
#include <HTTPClient.h>

#include <Arduino.h>
#include <U8g2lib.h>
#include <ArduinoJson.h>

#include <Adafruit_Sensor.h>
#include <Adafruit_BME280.h>

#include "time.h"

#ifdef U8X8_HAVE_HW_SPI
#include <SPI.h>
#endif
#ifdef U8X8_HAVE_HW_I2C
#include <Wire.h>
#endif

#define BME_SCK 13
#define BME_MISO 12
#define BME_MOSI 11
#define BME_CS 10

#define SEALEVELPRESSURE_HPA (1013.25)

Adafruit_BME280 bme; // I2C

U8G2_SH1106_128X64_NONAME_F_HW_I2C u8g2(U8G2_R0, /* reset=*/ U8X8_PIN_NONE, 10, 9);

short icon_size = 24;

// 'weather-pouring', 24x24px
const unsigned char epd_bitmap_weather_pouring [] PROGMEM = {
	0xff, 0xff, 0xff, 0xff, 0xff, 0xff, 0xff, 0xc1, 0xff, 0xff, 0x00, 0xff, 0x7f, 0x3c, 0xfe, 0x3f, 
	0x7e, 0xfc, 0x0f, 0xff, 0xfc, 0x87, 0xff, 0xfd, 0xf3, 0xff, 0xe1, 0xf9, 0xff, 0xc1, 0xf9, 0xff, 
	0x8f, 0xf9, 0xff, 0x9f, 0xf9, 0xcc, 0x9c, 0xf3, 0xcc, 0x8c, 0x67, 0x66, 0xce, 0x7f, 0x66, 0xfe, 
	0x7f, 0x66, 0xfe, 0x7f, 0x66, 0xfe, 0x7f, 0x73, 0xff, 0xff, 0xf3, 0xff, 0xff, 0xf3, 0xff, 0xff, 
	0xfb, 0xff, 0xff, 0xff, 0xff, 0xff, 0xff, 0xff
};
// 'weather-sunny', 24x24px
const unsigned char epd_bitmap_weather_sunny [] PROGMEM = {
	0xff, 0xff, 0xff, 0xff, 0xff, 0xff, 0xff, 0xff, 0xff, 0xff, 0xe7, 0xff, 0xff, 0xc3, 0xff, 0xff, 
	0xff, 0xff, 0xff, 0xff, 0xff, 0x8f, 0xc3, 0xf1, 0xcf, 0x81, 0xf3, 0xdf, 0x3c, 0xff, 0x7f, 0x7e, 
	0xfe, 0x7f, 0x7e, 0xfe, 0x7f, 0x7e, 0xfe, 0x7f, 0x7e, 0xfe, 0xff, 0x3c, 0xff, 0xcf, 0x81, 0xf3, 
	0x8f, 0xc3, 0xf1, 0xff, 0xff, 0xff, 0xff, 0xff, 0xff, 0xff, 0xc3, 0xff, 0xff, 0xe7, 0xff, 0xff, 
	0xff, 0xff, 0xff, 0xff, 0xff, 0xff, 0xff, 0xff
};
// 'weather-cloudy', 24x24px
const unsigned char epd_bitmap_weather_cloudy [] PROGMEM = {
	0xff, 0xff, 0xff, 0xff, 0xff, 0xff, 0xff, 0xff, 0xff, 0xff, 0xff, 0xff, 0xff, 0xff, 0xff, 0xff, 
	0xc1, 0xff, 0xff, 0x00, 0xff, 0x7f, 0x3c, 0xfe, 0x3f, 0x7e, 0xfc, 0x0f, 0xff, 0xfc, 0x87, 0xff, 
	0xfd, 0xf3, 0xff, 0xe1, 0xf9, 0xff, 0xc1, 0xf9, 0xff, 0x8f, 0xf9, 0xff, 0x9f, 0xf9, 0xff, 0x9f, 
	0xf3, 0xff, 0x8f, 0x07, 0x00, 0xc0, 0x0f, 0x00, 0xe0, 0xff, 0xff, 0xff, 0xff, 0xff, 0xff, 0xff, 
	0xff, 0xff, 0xff, 0xff, 0xff, 0xff, 0xff, 0xff
};
// 'water-percent', 24x24px
const unsigned char epd_bitmap_water_percent [] PROGMEM = {
	0xff, 0xff, 0xff, 0xff, 0xff, 0xff, 0xff, 0xff, 0xff, 0xff, 0xff, 0xff, 0xff, 0xe7, 0xff, 0xff, 
	0xc3, 0xff, 0xff, 0x81, 0xff, 0xff, 0x81, 0xff, 0xff, 0x00, 0xff, 0x7f, 0x00, 0xff, 0x7f, 0x46, 
	0xfe, 0x7f, 0x66, 0xfe, 0x3f, 0x30, 0xfc, 0x3f, 0x18, 0xfc, 0x3f, 0x0c, 0xfc, 0x3f, 0x66, 0xfc, 
	0x7f, 0x62, 0xfe, 0x7f, 0x00, 0xfe, 0xff, 0x00, 0xff, 0xff, 0xc3, 0xff, 0xff, 0xff, 0xff, 0xff, 
	0xff, 0xff, 0xff, 0xff, 0xff, 0xff, 0xff, 0xff
};
// 'wifi-strength-3', 14x14px
const unsigned char epd_bitmap_wifi_strength_3 [] PROGMEM = {
	0xff, 0x3f, 0xff, 0x3f, 0x07, 0x38, 0xf1, 0x23, 0xfc, 0x0f, 0x09, 0x24, 0x03, 0x30, 0x07, 0x38, 
	0x0f, 0x3c, 0x0f, 0x3c, 0x1f, 0x3e, 0x3f, 0x3f, 0xff, 0x3f, 0xff, 0x3f
};
// 'weather-lightning', 20x20px
const unsigned char epd_bitmap_weather_lightning [] PROGMEM = {
	0xff, 0xff, 0x0f, 0xff, 0xff, 0x0f, 0x7f, 0xe0, 0x0f, 0x3f, 0xc6, 0x0f, 0x9f, 0x9f, 0x0f, 0xc7, 
	0xbf, 0x0f, 0xc3, 0xbf, 0x0f, 0xf9, 0x3f, 0x0c, 0xf9, 0xff, 0x08, 0xf9, 0xf3, 0x09, 0xf9, 0xf1, 
	0x09, 0xf3, 0xf9, 0x08, 0x87, 0x31, 0x0c, 0xff, 0xf0, 0x0f, 0xff, 0xfb, 0x0f, 0xff, 0xfb, 0x0f, 
	0xff, 0xff, 0x0f, 0xff, 0xff, 0x0f, 0xff, 0xff, 0x0f, 0xff, 0xff, 0x0f
};
// 'weather-snowy', 20x20px
const unsigned char epd_bitmap_weather_snowy [] PROGMEM = {
	0xff, 0xff, 0x0f, 0xff, 0xff, 0x0f, 0x7f, 0xe0, 0x0f, 0x3f, 0xc6, 0x0f, 0x9f, 0x9f, 0x0f, 0xc7, 
	0xbf, 0x0f, 0xc3, 0xbf, 0x0f, 0xf9, 0x3f, 0x0c, 0xf9, 0xff, 0x08, 0xf9, 0xff, 0x09, 0xf9, 0xff, 
	0x09, 0xf3, 0xfb, 0x08, 0x47, 0x32, 0x0c, 0x7f, 0xc0, 0x0f, 0xff, 0xc0, 0x0f, 0x3f, 0xf0, 0x0f, 
	0x3f, 0xe0, 0x0f, 0xff, 0xe4, 0x0f, 0xff, 0xfc, 0x0f, 0xff, 0xff, 0x0f
};
// 'weather-fog', 20x20px
const unsigned char epd_bitmap_weather_fog [] PROGMEM = {
	0xff, 0xff, 0x0f, 0xff, 0xff, 0x0f, 0xff, 0xfb, 0x0f, 0x7f, 0xe0, 0x0f, 0x3f, 0xc6, 0x0f, 0x9f, 
	0x9f, 0x0f, 0xc7, 0xbf, 0x0f, 0xc3, 0x3f, 0x0f, 0xf9, 0x3f, 0x0c, 0xf9, 0xff, 0x08, 0xfd, 0xff, 
	0x09, 0xff, 0xff, 0x0f, 0x07, 0x38, 0x0e, 0x03, 0x10, 0x0c, 0xff, 0xff, 0x0f, 0xff, 0xff, 0x0f, 
	0x23, 0x00, 0x0c, 0x33, 0x00, 0x0c, 0xff, 0xff, 0x0f, 0xff, 0xff, 0x0f
};

const char* ssid = "C111";
const char* password = "abcdefabcdef987654321";

String serverPath = "https://api.open-meteo.com/v1/forecast?latitude=50.0138&longitude=20.987&current=temperature_2m,relative_humidity_2m,weather_code";

int temperature;
int relative_humidity;
int weather_code;

unsigned long delayTime;

const char* ntpServer = "pool.ntp.org";
const long  gmtOffset_sec = 3600;
const int   daylightOffset_sec = 3600;

struct tm timeinfo;
char timeHour[3];
char timeMinute[3];

void setup() {
  Serial.begin(115200); 

  WiFi.begin(ssid, password);
  Serial.println("Connecting");
  while(WiFi.status() != WL_CONNECTED) {
    delay(500);
  }

  unsigned status;

  Wire.begin(9, 10);
  // default settings
  status = bme.begin(0x76);  

  if (!status) {
        Serial.println("Could not find a valid BME280 sensor, check wiring, address, sensor ID!");
        Serial.print("SensorID was: 0x"); Serial.println(bme.sensorID(),16);
        Serial.print("        ID of 0xFF probably means a bad address, a BMP 180 or BMP 085\n");
        Serial.print("   ID of 0x56-0x58 represents a BMP 280,\n");
        Serial.print("        ID of 0x60 represents a BME 280.\n");
        Serial.print("        ID of 0x61 represents a BME 680.\n");
        while (1) delay(10);
    }

  delayTime = 1000;


  configTime(gmtOffset_sec, daylightOffset_sec, ntpServer);



  u8g2.begin();
}

void loop() {

  getNetworkValues();
  getLocalValues();
  getTime();

  u8g2.clearBuffer();					// clear the internal memory
  u8g2.setFontMode(0);
  u8g2.setDrawColor(1);

  // u8g2.setFont(u8g2_font_ncenB08_tr);	// choose a suitable font u8g2_font_pixelmordred_tf
  u8g2.setFont(u8g2_font_helvR12_tf);
  // u8g2.drawStr(0,10,"Hello World!");	// write something to the internal memory
  u8g2.drawBox(0, 20, 128, 44);

  u8g2.setCursor(8, 16);
  u8g2.print(String(timeHour) + ":" + String(timeMinute));

  // u8g2.drawStr(8, 16,"9:41");

  switch (weather_code) {
    case 0: 
      u8g2.drawXBMP(4, 20, icon_size, icon_size, epd_bitmap_weather_sunny);
      break;
    case 1:
    case 2:
    case 3:
      u8g2.drawXBMP(4, 20, icon_size, icon_size, epd_bitmap_weather_cloudy);
      break;
    case 51:
    case 53: 
    case 55: 
    case 56: 
    case 57: 
    case 61:
    case 63:
    case 65:
    case 66:
    case 67:
    case 80:
    case 81:
    case 82:
      u8g2.drawXBMP(4, 20, icon_size, icon_size, epd_bitmap_weather_pouring);
      break;
    default:
      u8g2.drawXBMP(4, 20, icon_size, icon_size, epd_bitmap_weather_sunny);
      break;
  }

  u8g2.setFont(u8g2_font_helvR10_tf);
  u8g2.setFontMode(0);
  u8g2.setDrawColor(0);
  u8g2.setCursor(28, 38);
  u8g2.print(String(temperature) + " C");
  // u8g2.drawStr(28, 38, String(temperature) + " C");

  u8g2.setFont(u8g2_font_helvR10_tf);
  u8g2.setFontMode(0);
  u8g2.setDrawColor(0);
  u8g2.drawStr(8, 58,"Tarnow");

  u8g2.setFontMode(0);
  u8g2.setDrawColor(1);
  u8g2.drawXBMP(64, 20, icon_size, icon_size, epd_bitmap_water_percent);

  u8g2.setFont(u8g2_font_helvR10_tf);
  u8g2.setFontMode(0);
  u8g2.setDrawColor(0);
  u8g2.setCursor(90, 38);
  u8g2.print(String(relative_humidity) + " %");
  // u8g2.drawStr(90, 38, String(relative_humidity) + " %");

  u8g2.setFontMode(1);
  u8g2.setDrawColor(0);
  u8g2.drawXBMP(102, 4, 14, 14, epd_bitmap_wifi_strength_3);

  u8g2.sendBuffer();					// transfer internal memory to the display

  delay(600);


}

void getTime() {
  if(!getLocalTime(&timeinfo)){
      Serial.println("Failed to obtain time");
      return;
    }

  
  strftime(timeHour,3, "%H", &timeinfo);
  strftime(timeMinute,3, "%M", &timeinfo);

}


void getLocalValues() {
  temperature = bme.readTemperature();
  relative_humidity = bme.readHumidity();
}


void getNetworkValues() {
  if(WiFi.status()== WL_CONNECTED){
      HTTPClient http;
      
      // Your Domain name with URL path or IP address with path
      http.begin(serverPath.c_str());
      
      // Send HTTP GET request
      int httpResponseCode = http.GET();
      
      if (httpResponseCode>0) {
        // Serial.print("HTTP Response code: ");
        // Serial.println(httpResponseCode);
        String payload = http.getString();
        // Serial.println(payload);

        JsonDocument doc;
        deserializeJson(doc, payload);

        // temperature = doc["current"]["temperature_2m"];
        // relative_humidity = doc["current"]["relative_humidity_2m"];
        weather_code = doc["current"]["weather_code"];

        // Serial.println(temperature);
        // Serial.println(relative_humidity);
        // Serial.println(weather_code);

      }
      else {
        Serial.print("Error code: ");
        Serial.println(httpResponseCode);
      }
      // Free resources
      http.end();
    }
    else {
      Serial.println("WiFi Disconnected");
    }
}

